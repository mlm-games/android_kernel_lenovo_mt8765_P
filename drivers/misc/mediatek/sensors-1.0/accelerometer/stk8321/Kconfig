## drivers/misc/mediatek/sensors-1.0/accelerometer/stk8321/Kconfig
```kconfig
config MTK_STK832X
	bool "STK832X for MediaTek package"
	default y
	help
        If this option is set, it will support stk832x Accelerometer.
```

## drivers/misc/mediatek/sensors-1.0/capsensor/Kconfig
```kconfig
config MTK_KERNEL_CAPSENSOR
	tristate "MTK_KERNEL_CAPSENSOR for MediaTek package"
	default n
	help
	  It support different MTK_KERNEL_CAPSENSOR.
          If this option is set,
	  it will support
          MTK_KERNEL_CAPSENSOR.
```
